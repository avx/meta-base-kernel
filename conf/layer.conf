## conf/layer.conf
```bitbake
# We have a conf and classes directory, add to BBPATH
BBPATH .= ":${LAYERDIR}"

# We have recipes-* directories, add to BBFILES
BBFILES += "${LAYERDIR}/recipes-*/*/*.bb \
            ${LAYERDIR}/recipes-*/*/*.bbappend \
            ${LAYERDIR}/classes/*.bbclass \
"


BBFILE_COLLECTIONS += "basekernel"
BBFILE_PATTERN_basekernel = "^${LAYERDIR}/"
BBFILE_PRIORITY_basekernel = "7"
LAYERVERSION_basekernel = "1"
LAYERSERIES_COMPAT_basekernel = "zeus"
LAYERDEPENDS_basekernel = "core"
```
